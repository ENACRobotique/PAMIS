## 2026/pamis_2026/main/Kconfig.projbuild
```kconfig
menu "WiFi network credentials"
    config WIFI_STA_SSID
        string "WiFi STA SSID"
        default "ssid"
        help
            SSID du wifi auquel se connecter
    config WIFI_STA_PASSWORD
        string "WiFi STA Password"
        default "P@ssword"
        help
            Mot de passe du WiFi auquel se connecter
    config WIFI_AP_SSID
        string "WiFi AP SSID"
        default "Pami AP"
        help
            SSID du wifi AP créé en cas d'échec de la connexion au WiFi STA
    config WIFI_AP_PASSWORD
        string "WiFi AP Password"
        default "papimamie"
        help
            Mot de passe du wifi AP créé en cas d'échec de la connexion au WiFi STA
endmenu
```

## 2026/pamis_2026/sdkconfig.defaults
```kconfig
#
# Flash
#
CONFIG_ESPTOOLPY_FLASHSIZE_8MB=y
CONFIG_ESPTOOLPY_FLASHSIZE="8MB"

#
# Partition Table
#

CONFIG_PARTITION_TABLE_CUSTOM=y
CONFIG_PARTITION_TABLE_CUSTOM_FILENAME="partitions.csv"
CONFIG_PARTITION_TABLE_FILENAME="partitions.csv"

#
# HTTP Server
#

CONFIG_HTTPD_WS_SUPPORT=y
# end of HTTP Server
```
